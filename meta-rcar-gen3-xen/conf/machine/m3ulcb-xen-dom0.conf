## meta-rcar-gen3-xen/conf/machine/m3ulcb-xen-dom0.conf
```bitbake
#@TYPE: Machine
#@NAME: M3ULCB machine
#@DESCRIPTION: Machine configuration for running M3ULCB

require conf/machine/include/m3ulcb-xen.inc

KERNEL_DEVICETREE = "renesas/r8a7796-m3ulcb-dom0.dtb"
```
